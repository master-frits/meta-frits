## conf/layer.conf
```bitbake
# We have a conf and classes directory, add to BBPATH
BBPATH .= ":${LAYERDIR}"

# We have recipes-* directories, add to BBFILES
BBFILES += "${LAYERDIR}/recipes-*/*/*.bb \
            ${LAYERDIR}/recipes-*/*/*.bbappend"

BBFILE_COLLECTIONS += "meta-frits"
BBFILE_PATTERN_meta-frits = "^${LAYERDIR}/"
BBFILE_PRIORITY_meta-frits = "6"

LAYERDEPENDS_meta-frits = "core"
LAYERSERIES_COMPAT_meta-frits = "walnascar styhead"
```
